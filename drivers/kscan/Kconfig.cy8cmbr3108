## drivers/kscan/Kconfig.cy8cmbr3108
```kconfig
# Copyright (c) 2020 NXP
# Copyright (c) 2020 Teslabs Engineering S.L.
# SPDX-License-Identifier: Apache-2.0

menuconfig KSCAN_CY8CMBR3108
	bool "CY8CMBR3108 capacitive touch panel driver"
	depends on I2C
	help
	  Enable driver for Cypress CY8CMBR3108

if KSCAN_CY8CMBR3108

config KSCAN_CY8CMBR3108_PERIOD
	int "Sample period"
	depends on !KSCAN_CY8CMBR3108_INTERRUPT
	default 500
	help
	  Sample period in milliseconds when in polling mode.

config KSCAN_CY8CMBR3108_INTERRUPT
	bool "Enable interrupt"	
	default y
	help
	  Enable interrupt support (requires GPIO).

endif # KSCAN_CY8CMBR3108
```

## dts/bindings/kscan/cypress,cy8cmbr3108.yaml
```yaml
# Copyright (c) 2020 NXP
# SPDX-License-Identifier: Apache-2.0

description: Cypress CY8CMBR3108 capacitive touch panels

compatible: "cypress,cy8cmbr3108"

include: [kscan.yaml, i2c-device.yaml]

properties:
    int-gpios:
      type: phandle-array
      required: false
```

## dts/bindings/sensor/capella,cm32183.yaml
```yaml
# Copyright (c) 2019, Linaro Limited
# SPDX-License-Identifier: Apache-2.0

description: |
    Capella CM32183 Light Sensor. 

compatible: "capella,cm32183"

include: [sensor-device.yaml, i2c-device.yaml]

properties:
    int-gpios:
      type: phandle-array
      required: false
      description: |
        The INT pin defaults to active low when produced by the sensor.
        The property value should ensure the flags properly describe the
        signal that is presented to the driver.
```

## dts/bindings/sensor/st,stts75.yaml
```yaml
# Copyright (c) 2019, Linaro Limited
# SPDX-License-Identifier: Apache-2.0

description: |
    Capella STTS75 Light Sensor. 

compatible: "st,stts75"

include: [sensor-device.yaml, i2c-device.yaml]

properties:
    int-gpios:
      type: phandle-array
      required: false
      description: |
        The INT pin defaults to active low when produced by the sensor.
        The property value should ensure the flags properly describe the
        signal that is presented to the driver.
```
